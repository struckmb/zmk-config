## config/west.yml
```yaml
manifest:
  remotes:
    - name: zmkfirmware
      url-base: https://github.com/zmkfirmware
    - name: urob
      url-base: https://github.com/urob
    - name: beekeeb
      url-base: https://github.com/beekeeb

  projects:
    - name: zmk
      remote: zmkfirmware
      # revision: main // main is unstable
      revision: v0.3
      import: app/west.yml
    - name: zmk-helpers
      remote: urob
      revision: main
    - name: zmk-keyboard-toucan2
      remote: beekeeb
      revision: main

  self:
    path: config
```
